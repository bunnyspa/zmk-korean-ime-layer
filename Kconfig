## Kconfig
```kconfig
config ZMK_KOREAN_IME_LAYER
    bool "Enable Korean IME-driven layer switching"
    depends on RAW_HID
    default n
    help
      Listens for Raw HID packets (marker 0xD5) reporting the Korean
      IME state from a host application and switches between two
      configured layers accordingly.

      Pair with korean-ime-reporter-windows (or any host app that
      speaks the same protocol) running on the connected PC.
```

## dts/bindings/zmk,korean-ime-layer.yaml
```yaml
description: |
  Korean IME-driven layer switcher.

  Activates one of two configured layers based on Raw HID packets reporting
  the host's Korean IME state. When the host reports no Korean IME on the
  foreground window, both layers are deactivated and ZMK's always-active
  layer 0 takes over.

compatible: "zmk,korean-ime-layer"

properties:
  korean-layer:
    type: int
    required: true
    description: Layer index to activate when the host IME is in 한글 mode.

  english-layer:
    type: int
    required: true
    description: Layer index to activate when the host IME is in 영문 mode.
```
